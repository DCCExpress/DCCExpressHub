#include "MiniIli9342Display.h"

namespace {

// Printable ASCII 32..126.
// 95 glyphs * 8 rows = only 760 bytes in flash.
const uint8_t FONT_8X8[95][8] PROGMEM = {
  {0x00, 0x00, 0x00, 0x00, 0x00, 0x00, 0x00, 0x00}, //  32  
  {0x40, 0x40, 0x40, 0x40, 0x40, 0x00, 0x00, 0x40}, //  33 !
  {0x60, 0x60, 0x60, 0x00, 0x00, 0x00, 0x00, 0x00}, //  34 0x22
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  {0x00, 0x00, 0x00, 0x00, 0x68, 0x58, 0x00, 0x00}, // 126 ~
};

}

void MiniIli9342Display::resetPanel() {
  digitalWrite(
      TFT_RST,
      HIGH);

  delay(5);

  digitalWrite(
      TFT_RST,
      LOW);

  delay(20);

  digitalWrite(
      TFT_RST,
      HIGH);

  delay(120);
}

void MiniIli9342Display::writeCommand(
    uint8_t command) {
  _spi->beginTransaction(
      SPISettings(
          SPI_HZ,
          MSBFIRST,
          SPI_MODE0));

  digitalWrite(
      TFT_DC,
      LOW);

  digitalWrite(
      TFT_CS,
      LOW);

  _spi->transfer(
      command);

  digitalWrite(
      TFT_CS,
      HIGH);

  _spi->endTransaction();
}

void MiniIli9342Display::writeData(
    uint8_t value) {
  writeData(
      &value,
      1);
}

void MiniIli9342Display::writeData(
    const uint8_t* data,
    size_t length) {
  if (
      !data ||
      length == 0
  ) {
    return;
  }

  _spi->beginTransaction(
      SPISettings(
          SPI_HZ,
          MSBFIRST,
          SPI_MODE0));

  digitalWrite(
      TFT_DC,
      HIGH);

  digitalWrite(
      TFT_CS,
      LOW);

  _spi->writeBytes(
      data,
      length);

  digitalWrite(
      TFT_CS,
      HIGH);

  _spi->endTransaction();
}

void MiniIli9342Display::writeCommandData(
    uint8_t command,
    const uint8_t* data,
    size_t length) {
  writeCommand(
      command);

  if (
      data &&
      length
  ) {
    writeData(
        data,
        length);
  }
}

void MiniIli9342Display::begin() {
  pinMode(
      TFT_CS,
      OUTPUT);

  pinMode(
      TFT_DC,
      OUTPUT);

  pinMode(
      TFT_RST,
      OUTPUT);

  pinMode(
      TFT_BL,
      OUTPUT);

  digitalWrite(
      TFT_CS,
      HIGH);

  digitalWrite(
      TFT_DC,
      HIGH);

  digitalWrite(
      TFT_BL,
      LOW);

  _spi->begin(
      TFT_SCLK,
      TFT_MISO,
      TFT_MOSI,
      TFT_CS);

  resetPanel();

  // ILI9342C initialization used by M5Stack-class panels.
  {
    const uint8_t data[] = {
        0xFF,
        0x93,
        0x42};

    writeCommandData(
        0xC8,
        data,
        sizeof(data));
  }

  {
    const uint8_t data[] = {
        0x12,
        0x12};

    writeCommandData(
        0xC0,
        data,
        sizeof(data));
  }

  {
    const uint8_t data[] = {
        0x03};

    writeCommandData(
        0xC1,
        data,
        sizeof(data));
  }

  {
    const uint8_t data[] = {
        0xF2};

    writeCommandData(
        0xC5,
        data,
        sizeof(data));
  }

  {
    const uint8_t data[] = {
        0xE0};

    writeCommandData(
        0xB0,
        data,
        sizeof(data));
  }

  {
    const uint8_t data[] = {
        0x01,
        0x00,
        0x00};

    writeCommandData(
        0xF6,
        data,
        sizeof(data));
  }

  {
    const uint8_t data[] = {
        0x00,
        0x0C,
        0x11,
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        0x34,
        0x0F};

    writeCommandData(
        0xE0,
        data,
        sizeof(data));
  }

  {
    const uint8_t data[] = {
        0x00,
        0x0B,
        0x11,
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        0x33,
        0x0F};

    writeCommandData(
        0xE1,
        data,
        sizeof(data));
  }

  {
    const uint8_t data[] = {
        0x08,
        0x82,
        0x1D,
        0x04};

    writeCommandData(
        0xB6,
        data,
        sizeof(data));
  }

  // 16-bit RGB565.
  {
    const uint8_t data[] = {
        0x55};

    writeCommandData(
        0x3A,
        data,
        sizeof(data));
  }

  // Landscape orientation matching the normal M5Stack rotation.
  {
    const uint8_t data[] = {
        0xA8};

    writeCommandData(
        0x36,
        data,
        sizeof(data));
  }

  // Exit idle mode.
  writeCommand(
      0x38);

  // Sleep out.
  writeCommand(
      0x11);

  delay(120);

  // Display on.
  writeCommand(
      0x29);

  delay(20);

  digitalWrite(
      TFT_BL,
      HIGH);

  clear();

  setCursor(
      0,
      0);

  setTextSize(
      1);

  setTextColor(
      WHITE,
      BLACK);
}

void MiniIli9342Display::setAddressWindow(
    uint16_t x,
    uint16_t y,
    uint16_t w,
    uint16_t h) {
  if (
      w == 0 ||
      h == 0
  ) {
    return;
  }

  const uint16_t x2 =
      x +
      w -
      1;

  const uint16_t y2 =
      y +
      h -
      1;

  uint8_t data[4];

  data[0] =
      x >>
      8;

  data[1] =
      x &
      0xFF;

  data[2] =
      x2 >>
      8;

  data[3] =
      x2 &
      0xFF;

  writeCommandData(
      0x2A,
      data,
      4);

  data[0] =
      y >>
      8;

  data[1] =
      y &
      0xFF;

  data[2] =
      y2 >>
      8;

  data[3] =
      y2 &
      0xFF;

  writeCommandData(
      0x2B,
      data,
      4);

  writeCommand(
      0x2C);
}

void MiniIli9342Display::pushColor(
    uint16_t color,
    uint32_t count) {
  if (
      count == 0
  ) {
    return;
  }

  uint8_t buffer[128];

  for (
      size_t index = 0;
      index < sizeof(buffer);
      index += 2
  ) {
    buffer[index] =
        color >>
        8;

    buffer[
        index +
        1] =
        color &
        0xFF;
  }

  _spi->beginTransaction(
      SPISettings(
          SPI_HZ,
          MSBFIRST,
          SPI_MODE0));

  digitalWrite(
      TFT_DC,
      HIGH);

  digitalWrite(
      TFT_CS,
      LOW);

  while (
      count >
      0
  ) {
    const uint32_t pixels =
        min<uint32_t>(
            count,
            sizeof(buffer) /
                2);

    _spi->writeBytes(
        buffer,
        pixels *
            2);

    count -=
        pixels;
  }

  digitalWrite(
      TFT_CS,
      HIGH);

  _spi->endTransaction();
}

void MiniIli9342Display::clear(
    uint16_t color) {
  setAddressWindow(
      0,
      0,
      WIDTH,
      HEIGHT);

  pushColor(
      color,
      static_cast<uint32_t>(
          WIDTH) *
          HEIGHT);

  _cursorX =
      0;

  _cursorY =
      0;
}

void MiniIli9342Display::setCursor(
    int16_t x,
    int16_t y) {
  _cursorX =
      x;

  _cursorY =
      y;
}

void MiniIli9342Display::setTextSize(
    uint8_t size) {
  _textSize =
      constrain(
          size,
          1,
          3);
}

void MiniIli9342Display::setTextColor(
    uint16_t foreground,
    uint16_t background) {
  _foreground =
      foreground;

  _background =
      background;
}

void MiniIli9342Display::newline() {
  _cursorX =
      0;

  _cursorY +=
      9 *
      _textSize;
}

void MiniIli9342Display::drawChar(
    char c) {
  if (c == '\r') {
    return;
  }

  if (c == '\n') {
    newline();
    return;
  }

  if (
      c < 32 ||
      c > 126
  ) {
    c =
        '?';
  }

  const uint8_t glyphWidth =
      8 *
      _textSize;

  const uint8_t glyphHeight =
      8 *
      _textSize;

  if (
      _cursorX +
          glyphWidth >
      WIDTH
  ) {
    newline();
  }

  if (
      _cursorY +
          glyphHeight >
      HEIGHT
  ) {
    return;
  }

  // Maximum text size is 3 => 24 * 24 pixels.
  uint16_t pixels[
      24 *
      24];

  size_t output =
      0;

  const uint8_t glyphIndex =
      static_cast<uint8_t>(
          c -
          32);

  for (
      uint8_t row = 0;
      row < 8;
      ++row
  ) {
    const uint8_t bits =
        pgm_read_byte(
            &FONT_8X8[
                glyphIndex][row]);

    for (
        uint8_t sy = 0;
        sy < _textSize;
        ++sy
    ) {
      for (
          uint8_t column = 0;
          column < 8;
          ++column
      ) {
        const bool on =
            (
                bits &
                (
                    0x80 >>
                    column
                )
            ) !=
            0;

        const uint16_t color =
            on
                ? _foreground
                : _background;

        for (
            uint8_t sx = 0;
            sx < _textSize;
            ++sx
        ) {
          pixels[
              output++] =
              color;
        }
      }
    }
  }

  setAddressWindow(
      _cursorX,
      _cursorY,
      glyphWidth,
      glyphHeight);

  _spi->beginTransaction(
      SPISettings(
          SPI_HZ,
          MSBFIRST,
          SPI_MODE0));

  digitalWrite(
      TFT_DC,
      HIGH);

  digitalWrite(
      TFT_CS,
      LOW);

  for (
      size_t index = 0;
      index < output;
      ++index
  ) {
    _spi->transfer16(
        pixels[index]);
  }

  digitalWrite(
      TFT_CS,
      HIGH);

  _spi->endTransaction();

  _cursorX +=
      glyphWidth;
}

void MiniIli9342Display::print(
    const String& text) {
  for (
      size_t index = 0;
      index < text.length();
      ++index
  ) {
    drawChar(
        text.charAt(index));
  }
}

void MiniIli9342Display::print(
    const char* text) {
  if (!text) {
    return;
  }

  while (*text) {
    drawChar(
        *text++);
  }
}

void MiniIli9342Display::print(
    uint32_t value) {
  print(
      String(value));
}

void MiniIli9342Display::println() {
  newline();
}

void MiniIli9342Display::println(
    const String& text) {
  print(
      text);

  newline();
}

void MiniIli9342Display::println(
    const char* text) {
  print(
      text);

  newline();
}

void MiniIli9342Display::println(
    uint32_t value) {
  print(
      value);

  newline();
}
