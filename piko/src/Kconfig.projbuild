## piko/src/Kconfig.projbuild
```kconfig
menu "DCCExpress PIKO handheld"
    config PIKO_HW_INPUT_PROBE
        bool "Enable conservative read-only GPIO input diagnostics"
        default n
        help
            Prints changes on GPIO 32/33/34/35/36/39 to serial console.
            Does not drive outputs or enable pull resistors.
    config PIKO_WIFI_SSID
        string "Wi-Fi SSID (stored in local sdkconfig, do not commit)"
        default ""
    config PIKO_WIFI_PASSWORD
        string "Wi-Fi password (stored in local sdkconfig, do not commit)"
        default ""
    config PIKO_AP_SSID
        string "PIKO standalone Wi-Fi network name"
        default "PIKO-Update"
    config PIKO_AP_PASSWORD
        string "PIKO standalone Wi-Fi password (minimum 8 characters)"
        default ""
        help
            Configure a private 8-63 character WPA2 password before starting the access point.
            Empty password prevents Wi-Fi from starting.
    config PIKO_OTA_PASSWORD
        string "OTA update password (stored in local sdkconfig, do not commit)"
        default ""
        help
            Set a non-empty private password before using firmware updates.
            Empty disables all update requests.
    config PIKO_OTA_PORT
        int "Local OTA HTTP web server port"
        range 1024 65535
        default 8080
    config PIKO_LCD_TEST
        bool "Enable experimental LCD RGB test (GUESS: VSPI candidate)"
        default y
        help
            Experimental ST7789-compatible RGB stripe test. GPIOs below are guesses, not verified PIKO wiring. Disable this if required.
    config PIKO_LCD_MOSI
        int "LCD MOSI GPIO (verified only)"
        range -1 39
        default 23
        depends on PIKO_LCD_TEST
    config PIKO_LCD_CLK
        int "LCD clock GPIO (verified only)"
        range -1 39
        default 18
        depends on PIKO_LCD_TEST
    config PIKO_LCD_CS
        int "LCD chip-select GPIO (verified only)"
        range -1 39
        default 5
        depends on PIKO_LCD_TEST
    config PIKO_LCD_DC
        int "LCD data/command GPIO (verified only)"
        range -1 39
        default 21
        depends on PIKO_LCD_TEST
    config PIKO_LCD_RESET
        int "LCD reset GPIO (verified only)"
        range -1 39
        default 22
        depends on PIKO_LCD_TEST
    config PIKO_HUB_IP
        string "DCCExpressHub IPv4 address"
        default "192.168.1.204"
    config PIKO_Z21_PORT
        int "DCCExpressHub Z21 UDP port"
        range 1 65535
        default 21105
    config PIKO_LOCO_ADDRESS
        int "Initial locomotive address"
        range 1 10239
        default 10
endmenu
```
